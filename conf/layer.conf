## conf/layer.conf
```bitbake
# We have a conf and classes directory, add to BBPATH
BBPATH .= ":${LAYERDIR}"

# We have recipes-* directories, add to BBFILES
BBFILES += "${LAYERDIR}/recipes-*/*/*.bb \
            ${LAYERDIR}/recipes-*/*/*.bbappend"

BBFILE_COLLECTIONS += "meta-vc-mipi"
BBFILE_PATTERN_meta-vc-mipi = "^${LAYERDIR}/"
BBFILE_PRIORITY_meta-vc-mipi = "30"
LAYERVERSION_meta-vc-mipi = "2"
LAYERSERIES_COMPAT_meta-vc-mipi = "scarthgap"

KERNEL_DEVICETREE:append:phyboard-pollux-imx8mp-3 = " \
    freescale/imx8mp-phyboard-pollux-vc-sony-2lanes-csi1.dtbo \
    freescale/imx8mp-phyboard-pollux-vc-sony-4lanes-csi1.dtbo \
    freescale/imx8mp-phyboard-pollux-vc-sony-2lanes-csi2.dtbo \
    freescale/imx8mp-phyboard-pollux-vc-sony-4lanes-csi2.dtbo \
"

IMAGE_INSTALL:append:phyboard-pollux-imx8mp-3 = "kernel-module-vc-mipi"
```
